## boards/shields/sofle_dongle/Kconfig.shield
```kconfig
config SHIELD_SOFLE_DONGLE
    def_bool $(shields_list_contains,sofle_dongle)
    select ZMK_SPLIT
    select ZMK_SPLIT_BLE
    select ZMK_SPLIT_ROLE_CENTRAL
```

## boards/shields/sofle_left_peripheral/Kconfig.defconfig
```kconfig
if SHIELD_SOFLE_LEFT_PERIPHERAL

config ZMK_SPLIT_ROLE_CENTRAL
    default n

config ZMK_SPLIT
    default y

config ZMK_KEYMAP
    default n

endif
```

## boards/shields/sofle_left_peripheral/Kconfig.shield
```kconfig
config SHIELD_SOFLE_LEFT_PERIPHERAL
    def_bool $(shields_list_contains,sofle_left_peripheral)
```

## boards/shields/sofle_right_peripheral/Kconfig.defconfig
```kconfig
if SHIELD_SOFLE_RIGHT_PERIPHERAL

config ZMK_SPLIT_ROLE_CENTRAL
    default n

config ZMK_SPLIT
    default y

config ZMK_KEYMAP
    default n

endif
```

## boards/shields/sofle_right_peripheral/Kconfig.shield
```kconfig
config SHIELD_SOFLE_RIGHT_PERIPHERAL
    def_bool $(shields_list_contains,sofle_right_peripheral)
```
